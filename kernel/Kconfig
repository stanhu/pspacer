## kernel/Kconfig
```kconfig
config NET_SCH_PSP
	tristate "Precise Software Pacer (PSP)"
	---help---
	  Say Y here if you want to include PSPacer module, which means
	  that you will be able to control precise pacing.

	  To compile this driver as a module, choose M here: the
	  module will be called sch_psp.

config NET_SCH_PSP_PKT_GAP
	bool "Allow individual per-packet gap"
	depends on NET_SCH_PSP
	---help---
	 Say Y if you want to every packets clocks provide additional
	 gaps/delay, based on TCP/IP tracking. Say N to use individual
	 packet clocks only to sorting packets in PFIFO or SFQ leaf queue
	 and delay only on busy queue.

	 To allow minimal packet delay, faster delivering and maximal channel
	 filling say N. To trying minimize packet lost if you believe to
	 algorithms ;) - say Y.

config NET_SCH_PSP_NO_SYN_FAIRNESS
	bool "Disable SYN fairness code"
	depends on NET_SCH_PSP
	---help---
	 Say N to SYN-fairness add-ons to PSP tracking code.
	 Say Y to disable this and produce more precise statistics
	 to automatic traffic tuning.

	 This code count SYN partially as retransmission packet and slow down
	 related connection and nearest IP-tree area.

	 Say N to possible solve native SYN-storms/peaks or attacks.
	 Possible (unsure) say Y with PKT_GAP feature.

config NET_SCH_PSP_EST
	bool "Enable rate estimators"
	depends on NET_SCH_PSP
	---help---
	 Say Y to estimate rate for psp qdisc and every class.
	 Some additional code will be used per every packet.
	 Not similar with "ESTIMATED_*" modes (this modes going
	 to deprecated state).

	 Say N to estimate only "rate auto".

config NET_SCH_PSP_RRR
	bool "Enable Retransmission-Round-Robin"
	depends on NET_SCH_PSP
	select NET_ACT_PEDIT
	---help---
	 Say Y to enable experemental RRR (Retransmission-Round-Robin) feature.
	 Additional data field will be added into TCP hash and IP tree items
	 and nodes.

	 Say Y to trying to distribute traffic across multiple outgoing
	 channels by TCP retransmissions. Also use packet editing to change
	 destination MACs on leaf.

config NET_SCH_PSP_FORCE_GAP
	bool "Enable minimal gap between every two packets"
	depends on NET_SCH_PSP
	---help---
	 Say Y to enable at least minimal (64 bytes in standard Ethernet) gap
	 between every two data packets.
	 This may break (or no) some too intellectual new Ethernet features
	 like some types of segmentations to improve rate precision with
	 price of little channel overhead.

	 If unsure in your Ethernet hardware - say Y.

config NET_SCH_PSP_FAST_SORT
	bool "BROKEN! Enable fast sorting (with hints) for pfifo leafs"
	depends on NET_SCH_PSP
	---help---
	 Currently BROKEN!

	 Say Y to enable fast packet sorting under "retransmission" modes
	 on pfifo leafs.

	 If you have very fast busy network, only PFIFO leafs and
	 use retransmission correction modes - try Y.

config NET_SCH_PSP_RATESAFE
	bool "Enable rate-safe gap justification strategy for modes 1&2"
	depends on NET_SCH_PSP
	---help---
	 Say Y to enable rate-safe gap justification strategy for modes 1&2.
	 Say N to only rounding up gaps.

	 If you test both and found Y is:
	    - prevent packet dropping by other side (mode 2);
	    - good perfomance (mode 1);
	 - use Y.
```

## trunk/kernel/Kconfig
```kconfig
config NET_SCH_PSP
	tristate "Precise Software Pacer (PSP)"
	---help---
	  Say Y here if you want to include PSPacer module, which means
	  that you will be able to control precise pacing.

	  To compile this driver as a module, choose M here: the
	  module will be called sch_psp.

config NET_SCH_PSP_PKT_GAP
	bool "Allow individual per-packet gap"
	depends on NET_SCH_PSP
	---help---
	 Say Y if you want to every packets clocks provide additional
	 gaps/delay, based on TCP/IP tracking. Say N to use individual
	 packet clocks only to sorting packets in PFIFO or SFQ leaf queue
	 and delay only on busy queue.
	 
	 To allow minimal packet delay, faster delivering and maximal channel
	 filling say N. To trying minimize packet lost if you believe to
	 algorithms ;) - say Y.

config NET_SCH_PSP_NO_SYN_FAIRNESS
	bool "Disable SYN fairness code"
	depends on NET_SCH_PSP
	---help---
	 Say N to SYN-fairness add-ons to PSP tracking code.
	 Say Y to disable this and produce more precise statistics
	 to automatic traffic tuning.
	 
	 This code count SYN partially as retransmission packet and slow down
	 related connection and nearest IP-tree area.
	 
	 Say N to possible solve native SYN-storms/peaks or attacks.
	 Possible (unsure) say Y with PKT_GAP feature.
```
